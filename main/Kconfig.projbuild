## main/Kconfig.projbuild
```kconfig
menu "Smartwatch OTA"

config OTA_FIRMWARE_URL
    string "HTTPS firmware binary URL"
    default ""
    help
        HTTPS URL pointing to the ESP-IDF application .bin used by OTA.
        Leave empty to disable OTA from the UI.

endmenu

menu "Smartwatch Debug"

config WATCH_HEAP_MONITOR
    bool "Enable periodic heap monitor log"
    default n
    help
        Logs heap, internal heap, and PSRAM every 30 seconds.
        Keep disabled for production firmware.

endmenu
```
